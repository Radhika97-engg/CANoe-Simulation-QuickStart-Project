/*@!Encoding:1252*/
//CAPL Program: CAN Message Repeater with ID Change (Intercepts message 0x100, copies its data, and re-transmits it as 0x200)
 

includes
{
  // No includes needed for this basic operation
}

variables
{
  // Declare a blank CAN message with ID 0x200
  message 0x200 modifiedMsg;
}

on message 0x100
{
  // --- Step 1: Copy the payload from received message (this) into modifiedMsg ---
  modifiedMsg.byte(0) = this.byte(0);
  modifiedMsg.byte(1) = this.byte(1);
  modifiedMsg.byte(2) = this.byte(2);
  modifiedMsg.byte(3) = this.byte(3);
  modifiedMsg.byte(4) = this.byte(4);
  modifiedMsg.byte(5) = this.byte(5);
  modifiedMsg.byte(6) = this.byte(6);
  modifiedMsg.byte(7) = this.byte(7);
  
  // --- Step 2: Copy the Data Length Code (DLC) ---
  modifiedMsg.dlc = this.dlc;
  
  // --- Step 3: Transmit the modified message with new ID (0x200) ---
  output(modifiedMsg);
}
/*@!Encoding:65001*/

  //CAPL Program: Vehicle Speed Monitor
  //Purpose: Monitor Vehicle Speed from incoming CAN message and log a warning if the speed exceeds 120 km/h.

includes
{
  // No includes needed
}

variables
{
  float vehicleSpeed; // Store decoded Vehicle Speed
}

on message 0x400
{
  // Extract Vehicle Speed from Byte 0
  vehicleSpeed = this.byte(0);

  // Check if speed exceeds safe threshold
  if (vehicleSpeed > 120)
  {
    write(" Vehicle Speed High Warning! Speed = %d km/h", vehicleSpeed);
  }
}
